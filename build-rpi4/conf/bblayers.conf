## build-rpi4/conf/bblayers.conf
```bitbake
# POKY_BBLAYERS_CONF_VERSION is increased each time build/conf/bblayers.conf
# changes incompatibly
POKY_BBLAYERS_CONF_VERSION = "2"

BBPATH = "${TOPDIR}"
BBFILES ?= ""

BBLAYERS ?= " \
  /home/gordon/yocto_rpi4_qt5/poky/meta \
  /home/gordon/yocto_rpi4_qt5/poky/meta-poky \
  /home/gordon/yocto_rpi4_qt5/build-rpi4/workspace \
  /home/gordon/yocto_rpi4_qt5/poky/meta-yocto-bsp \
  /home/gordon/yocto_rpi4_qt5/layer/meta-openembedded/meta-oe \
  /home/gordon/yocto_rpi4_qt5/layer/meta-openembedded/meta-python \
  /home/gordon/yocto_rpi4_qt5/layer/meta-raspberrypi \
  /home/gordon/yocto_rpi4_qt5/layer/meta-qt5 \
  /home/gordon/yocto_rpi4_qt5/layer/meta-openembedded/meta-networking \
  /home/gordon/yocto_rpi4_qt5/layer/meta-qt5-config \
  "
```
